## board/freescale/mx6rgbdt/Kconfig
```kconfig
if TARGET_MX6RGBDT

config SYS_BOARD
	default "mx6rgbdt"

config SYS_VENDOR
	default "freescale"

config SYS_CONFIG_NAME
	default "mx6rgbdt"

endif
```

## configs/mx6qrgbdt_defconfig
```kconfig
CONFIG_ARM=y
CONFIG_ARCH_MX6=y
CONFIG_TARGET_MX6RGBDT=y
CONFIG_SYS_EXTRA_OPTIONS="IMX_CONFIG=board/freescale/mx6rgbdt/mx6q_4x_mt41j128.cfg,MX6Q"
CONFIG_CMD_GPIO=y
```
